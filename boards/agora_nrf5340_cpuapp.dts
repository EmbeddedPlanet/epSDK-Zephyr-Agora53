/dts-v1/;
#include <arm/nordic/nrf5340_cpuapp_qkaa.dtsi>
#include "agora_cpuapp_common.dtsi"

/ {
	model = "Agora (cpuapp)";
	compatible = "ep,agora-cpuapp";

	chosen {
		zephyr,flash = &flash0;
		zephyr,code-partition = &slot0_partition;
		zephyr,sram = &sram0_image;
		zephyr,sram-secure-partition = &sram0_s;
		zephyr,sram-non-secure-partition = &sram0_ns;
	};
};

#include "agora_shared_sram.dtsi"
